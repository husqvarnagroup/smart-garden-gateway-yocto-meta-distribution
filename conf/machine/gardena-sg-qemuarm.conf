## conf/machine/gardena-sg-qemuarm.conf
```bitbake
#@TYPE: Machine
#@NAME: gardena-sg-qemuarm
#@DESCRIPTION: ARM926EJ-S (VersatilePB) under QEMU

# Same tune as the AT91SAM gateway to gain binary compatibility
require conf/machine/qemuarmv5.conf

MACHINEOVERRIDES =. "qemuarmv5:gardena-sg-qemu:"

MACHINE_FEATURES = "serial"
MACHINE_EXTRA_RRECOMMENDS = " kernel-modules"

PREFERRED_PROVIDER_virtual/kernel = "linux-yocto-tiny"

KERNEL_DEVICETREE:gardena-sg-qemuarm = "qemu-gardena-smart-gateway.dtb"

SERIAL_CONSOLES = "115200;ttyAMA0"

IMAGE_FSTYPES:append = " ext4"
IMAGE_ROOTFS_EXTRA_SPACE = "65536"

KERNEL_IMAGE_MAXSIZE = ""

RADIO_MODULE_PPP_TTY = "/dev/ttyAMA1"
HOMEKIT_HWAUTH = "0"

# For runqemu
QB_DTB = "qemu-gardena-smart-gateway.dtb"
QB_MEM = "-m 128"
QB_KERNEL_CMDLINE_APPEND = "rootwait"
```
