## conf/bblayers.conf.sample
```bitbake
# LAYER_CONF_VERSION is increased each time build/conf/bblayers.conf
# changes incompatibly
LCONF_VERSION = "7"

BBPATH = "${TOPDIR}"
BBFILES ?= ""

BBLAYERS ?= " \
  ##OEROOT##/meta \
  ##OEROOT##/../meta-mediatek \
  ##OEROOT##/../meta-distribution \
  ##OEROOT##/../meta-gardena \
  ##OEROOT##/../meta-homekit \
  ##OEROOT##/../meta-lemonbeat-firmware \
  ##OEROOT##/../meta-openembedded/meta-oe \
  ##OEROOT##/../meta-openembedded/meta-python \
  ##OEROOT##/../meta-openembedded/meta-networking \
  ##OEROOT##/../meta-readonly-rootfs-overlay \
  ##OEROOT##/../meta-swupdate \
  "
```

## conf/distro/gardena.conf
```bitbake
DISTRO = "gardena"
DISTRO_NAME = "GARDENA smart Gateway"
DISTRO_VERSION ?= "7"
DISTRO_VERSION_ID ?= "${DISTRO_VERSION}-snapshot-${DATE}"
DISTRO_CODENAME ?= "The Bleeding Edge"
DISTRO_UPDATE_URL_BASE ?= "http://gateway.iot.sg.dss.husqvarnagroup.net/images"

SDK_VENDOR = "-gardenasdk"
SDK_VERSION := "${@'${DISTRO_VERSION}'.replace('snapshot-${DATE}','snapshot')}"

MAINTAINER = "Open Source <smart.open.source@husqvarnagroup.com>"

TARGET_VENDOR = "-gardena"

LOCALCONF_VERSION = "1"

DISTRO_VERSION[vardepsexclude] = "DATE"
SDK_VERSION[vardepsexclude] = "DATE"

DISTRO_FEATURES ?= "${DISTRO_FEATURES_LIBC} systemd wifi ppp ipv6 ipv4 usrmerge"
DISTRO_FEATURES:remove = "pulseaudio"
# remove bluez5 as it is not currently needed
# enable again, if bluetooth will be used
DISTRO_FEATURES:remove = "bluez5"
DISTRO_FEATURES_BACKFILL_CONSIDERED += "sysvinit"
VIRTUAL-RUNTIME_init_manager = "systemd"
VIRTUAL-RUNTIME_initscripts = "systemd-compat-units"

PREFERRED_PROVIDER_u-boot-fw-utils = "libubootenv"
PREFERRED_VERSION_swupdate = "2023.05"
PREFERRED_VERSION_linux-yocto-tiny = "5.10.202%"

# Make sure that we only use our own recipe even though it's older.
# This is currently the only version that we know passed BCT.
PREFERRED_VERSION_mdns = "878.70.2"

# For accessory-server
PREFERRED_VERSION_mbedtls = "2.28.%"

# For reset-rm
PREFERRED_VERSION_libgpiod = "1.%"

PREFERRED_VERSION_openocd = "0.10%"

TCLIBC ?= "glibc"

SDK_NAME = "${DISTRO}-${TCLIBC}-${SDK_ARCH}-${IMAGE_BASENAME}-${TUNE_PKGARCH}"
SDKPATH = "/opt/${DISTRO}/${SDK_VERSION}"

GARDENAQEMUDEPS = "${@bb.utils.contains("INCOMPATIBLE_LICENSE", "GPL-3.0", "", "packagegroup-core-device-devel",d)}"
DISTRO_EXTRA_RDEPENDS:append:qemuarm = " ${GARDENAQEMUDEPS}"
DISTRO_EXTRA_RDEPENDS:append:qemuarm64 = " ${GARDENAQEMUDEPS}"
DISTRO_EXTRA_RDEPENDS:append:qemumips = " ${GARDENAQEMUDEPS}"
DISTRO_EXTRA_RDEPENDS:append:qemuppc = " ${GARDENAQEMUDEPS}"
DISTRO_EXTRA_RDEPENDS:append:qemux86 = " ${GARDENAQEMUDEPS}"
DISTRO_EXTRA_RDEPENDS:append:qemux86-64 = " ${GARDENAQEMUDEPS}"

TCLIBCAPPEND = ""

QEMU_TARGETS ?= "arm mips mipsel x86_64"

# TODO: Adjust this for GPL compliance. We have to use our own servers.
PREMIRRORS ??= "\
bzr://.*/.*   http://downloads.yoctoproject.org/mirror/sources/ \n \
cvs://.*/.*   http://downloads.yoctoproject.org/mirror/sources/ \n \
git://.*/.*   http://downloads.yoctoproject.org/mirror/sources/ \n \
gitsm://.*/.* http://downloads.yoctoproject.org/mirror/sources/ \n \
hg://.*/.*    http://downloads.yoctoproject.org/mirror/sources/ \n \
osc://.*/.*   http://downloads.yoctoproject.org/mirror/sources/ \n \
p4://.*/.*    http://downloads.yoctoproject.org/mirror/sources/ \n \
svn://.*/.*   http://downloads.yoctoproject.org/mirror/sources/ \n"

MIRRORS =+ "\
git://ssh.dev.azure.com/v3/HQV-Gardena/SG-Gateway/ git://github.com/husqvarnagroup/;protocol=http \n \
ftp://.*/.*      http://downloads.yoctoproject.org/mirror/sources/ \n \
http://.*/.*     http://downloads.yoctoproject.org/mirror/sources/ \n \
https://.*/.*    http://downloads.yoctoproject.org/mirror/sources/ \n"

# The CONNECTIVITY_CHECK_URI's are used to test whether we can succesfully
# fetch from the network (and warn you if not). To disable the test set
# the variable to be empty.
# Git example url: git://git.yoctoproject.org/yocto-firewall-test;protocol=git;rev=master
CONNECTIVITY_CHECK_URIS ?= "https://www.example.com/"

SANITY_TESTED_DISTROS ?= " \
            debian-10 \n \
            debian-11 \n \
            gentoo \n \
            ubuntu-20.04 \n \
            ubuntu-21.10 \n \
            ubuntu-22.04 \n \
            "
#
# OELAYOUT_ABI allows us to notify users when the format of TMPDIR changes in
# an incompatible way. Such changes should usually be detailed in the commit
# that breaks the format and have been previously discussed on the mailing list
# with general agreement from the core team.
#
OELAYOUT_ABI = "12"

# QA check settings - a little stricter than the OE-Core defaults
WARN_TO_ERROR_QA = "already-stripped compile-host-path install-host-path \
                    installed-vs-shipped ldflags pn-overrides rpaths staticdev \
                    useless-rpaths"
WARN_QA:remove = "${WARN_TO_ERROR_QA}"
ERROR_QA:append = " ${WARN_TO_ERROR_QA}"

require conf/distro/include/no-static-libs.inc
require conf/distro/include/yocto-uninative.inc
INHERIT += "uninative"

# OPKG feeds (development only!)
PACKAGE_FEED_URIS ?= "https://gateway-dev.iot.sg.dss.husqvarnagroup.net/continuous/main/${MACHINE}"
PACKAGE_FEED_BASE_PATHS = "ipk"
PACKAGE_FEED_ARCHS:mt7688 = "all mips32r2el-24kc-nf gardena_sg_mt7688"
PACKAGE_FEED_ARCHS:at91sam9x5 = "all armv5e gardena_sg_at91sam"

# Copy our U-Boot environment file to the image directory
UBOOT_ENV="uEnv"

# Limit kernel to the size of our kernel volumes
KERNEL_IMAGE_MAXSIZE = "4096"
KERNEL_IMAGE_MAXSIZE_gardena-sg-at91sam = "8192"

# This ensures that we always have a somewhat sensible hostname, even before
# changing it to "GARDENA-first-4-chars-of-gatewayid".
hostname:pn-base-files = "GARDENA"

# Store build information on target filesystem on /etc/build
INHERIT += "image-buildinfo"
IMAGE_BUILDINFO_VARS = "DISTRO DISTRO_VERSION DISTRO_VERSION_ID"

# Set a default timezone which is valid for most GARDENA customers
DEFAULT_TIMEZONE = "Europe/Zurich"

# Put relevant dependencies in SDK
# Caveat: As of dunfell, the Rust SDK package does not build for AT91SAM
TOOLCHAIN_HOST_TASK:append:mt7688 = " packagegroup-rust-cross-canadian-${MACHINE}"

# build migrationubi for at91
IMAGE_FSTYPES:append:at91sam9x5 = " migrationubi"
IMAGE_CLASSES:append:at91sam9x5 = " gardena_image_types"

# Prevent rtl8192cu from being loaded automatically
KERNEL_MODULE_PROBECONF += "rtl8192cu"
module_conf_rtl8192cu = "blacklist rtl8192cu"

# Prevent 8192cu from being loaded automatically
KERNEL_MODULE_PROBECONF += "8192cu"
module_conf_8192cu = "blacklist 8192cu"

# Prevent rtl8xxxu from being loaded automatically
KERNEL_MODULE_PROBECONF += "rtl8xxxu"
module_conf_rtl8xxxu = "blacklist rtl8xxxu"

# Disable initial U-Boot environment
UBOOT_INITIAL_ENV = ""

# Do not append ".rootfs" or else swupdate_add_artifacts() will fail
IMAGE_NAME_SUFFIX = ""
```

## conf/local.conf.sample
```bitbake
# Default to article no 19005
MACHINE ??= "gardena-sg-mt7688"

# Default to our company name
DISTRO ?= "gardena"

# Place caches outside of the build directory so that they survive a build
# directory wipe.
DL_DIR ?= "${HOME}/.cache/yocto/downloads"
SSTATE_DIR ?= "${HOME}/.cache/yocto/sstate-cache"

# Use OPKG packages
PACKAGE_CLASSES ?= "package_ipk"

# Enable collection of build statistics, reduce shared library files size
USER_CLASSES ?= "buildstats image-mklibs"

# Reduce image size by not installing recommended packages
NO_RECOMMENDATIONS = "1"

# By default disable interactive patch resolution, cause task to fail instead
PATCHRESOLVE = "noop"

# Disk Space Monitoring during the build
BB_DISKMON_DIRS ??= "\
    STOPTASKS,${TMPDIR},1G,100K \
    STOPTASKS,${DL_DIR},1G,100K \
    STOPTASKS,${SSTATE_DIR},1G,100K \
    STOPTASKS,/tmp,100M,100K \
    ABORT,${TMPDIR},100M,1K \
    ABORT,${DL_DIR},100M,1K \
    ABORT,${SSTATE_DIR},100M,1K \
    ABORT,/tmp,10M,1K"

# CONF_VERSION is increased each time build/conf/ changes incompatibly and is used to
# track the version of this file when it was generated. This can safely be ignored if
# this doesn't mean anything to you.
CONF_VERSION = "1"

# Query the National Vulnerability Database (NVD) for known security issues.
#INHERIT += "cve-check"

# Store information about builds, allow to analyze changes
INHERIT += "buildhistory"
BUILDHISTORY_COMMIT = "1"

# Archive source code for all packages getting built
# Disabled by default as not relevant for development builds and will be activated
# by auto.conf on CI infrastructure for release builds.
# Note: The COPYLEFT_LICENSE_EXCLUDE variable takes precedence over the
#       COPYLEFT_LICENSE_INCLUDE variable.
#INHERIT += "archiver"
ARCHIVER_MODE[src] = "original"
COPYLEFT_LICENSE_INCLUDE = "*"
COPYLEFT_LICENSE_EXCLUDE = 'CLOSED Proprietary'

# Copy license files to /usr/share/common-licenses in the image
# This fullfills a requirement of various BSD licenses for binary distribution
COPY_LIC_MANIFEST = "1"
COPY_LIC_DIRS = "1"

# Flags to facilitate remote debugging via GDB
# More information: https://docs.yoctoproject.org/dev-manual/common-tasks.html#using-the-gdbserver-method
#IMAGE_GEN_DEBUGFS = "1"
#IMAGE_FSTYPES_DEBUGFS = "tar.bz2"
#IMAGE_INSTALL_append = " gdbserver"

# Optional: Lower optimization to improve debugability
#DEBUG_BUILD = "1"
```

## conf/machine/gardena-sg-at91sam.conf
```bitbake
#@TYPE: Machine
#@Name: gardena-sg-at91sam
#@DESCRIPTION: gardena-sg-at91sam

require conf/machine/include/soc-family.inc
require conf/machine/include/arm/armv5/tune-arm926ejs.inc

SOC_FAMILY = "at91sam9"
MACHINE_FEATURES = "wifi serial"
MACHINE_EXTRA_RRECOMMENDS = " kernel-modules kernel-devicetree"
MACHINEOVERRIDES =. "at91sam9x5:"

PREFERRED_PROVIDER_virtual/kernel = "linux-yocto-tiny"
KERNEL_CLASSES += "kernel-fitimage"
KERNEL_IMAGETYPE ?= "fitImage"
KERNEL_DEVICETREE:at91sam9 = "at91sam9g25-gardena-smart-gateway.dtb"
SERIAL_CONSOLES ?= "115200;ttyS0"

UBOOT_CONFIG ??= "rom"
UBOOT_CONFIG[rom] = "gardena-smart-gateway-at91sam_defconfig"
UBOOT_ENTRYPOINT = "0x20008000"
UBOOT_LOADADDRESS = "0x20008000"
SPL_BINARY = "u-boot-with-spl.bin"

RADIO_MODULE_PPP_TTY = "/dev/ttyS1"
HOMEKIT_HWAUTH = "0"
HOMEKIT_SWAUTH_LS_URL_PROD = "https://prod.gardena.deviceauth.io"
HOMEKIT_SWAUTH_LS_URL_QA   = "https://prod.gardena.deviceauth.io"
HOMEKIT_SWAUTH_LS_URL_DEV  = "https://dev.gardena.deviceauth.io"

IMAGE_INSTALL += " \
    kernel-module-rtl8192cu \
    kernel-module-rtl8xxxu \
    linux-firmware-rtl8192cu \
"

# Don't include kernels in standard images
RDEPENDS:${KERNEL_PACKAGE_NAME}-base = ""
```

## conf/machine/gardena-sg-mt7688.conf
```bitbake
#@TYPE: Machine
#@NAME: gardena-sg-mt7688
#@DESCRIPTION: MIPS 32r2, Little Endian, Soft Float

require conf/machine/include/mips/tune-mips-24k.inc

# Don't include kernels in standard images
RDEPENDS:${KERNEL_PACKAGE_NAME}-base = ""

DEFAULTTUNE = "mips32r2el-24kc"

MACHINE_FEATURES = "wifi serial"
MACHINE_EXTRA_RRECOMMENDS = " kernel-modules kernel-devicetree"
MACHINEOVERRIDES =. "mt7688:"

PREFERRED_PROVIDER_virtual/kernel = "linux-yocto-tiny"

KERNEL_CLASSES += "kernel-fitimage"
KERNEL_IMAGETYPE ?= "fitImage"

KERNEL_DEVICETREE:mt7688 = "ralink/gardena_smart_gateway_mt7688.dtb"

# used by sysvinit_2 and systemd
SERIAL_CONSOLES ?= "115200;ttyS0"

UBOOT_CONFIG ??= "rom"
UBOOT_CONFIG[rom] = "gardena-smart-gateway-mt7688_defconfig"
UBOOT_ENTRYPOINT="0x80000400"
UBOOT_LOADADDRESS="0x80000000"
SPL_BINARY = "u-boot-with-spl.bin"

RADIO_MODULE_PPP_TTY = "/dev/ttyS1"
HOMEKIT_HWAUTH = "1"
```

## recipes-kernel/linux/gardena-sg-mt7688/defconfig
```kconfig
CONFIG_DEFAULT_HOSTNAME="mt7688"
CONFIG_TASKSTATS=y
CONFIG_TASK_DELAY_ACCT=y
CONFIG_TASK_XACCT=y
CONFIG_TASK_IO_ACCOUNTING=y
CONFIG_IKCONFIG=y
CONFIG_IKCONFIG_PROC=y
CONFIG_NAMESPACES=y
CONFIG_CC_OPTIMIZE_FOR_SIZE=y
CONFIG_EMBEDDED=y
CONFIG_RALINK=y
CONFIG_SOC_MT7620=y
CONFIG_CPU_MIPS32_R2=y
CONFIG_PACKET=y
CONFIG_UNIX=y
CONFIG_INET=y
CONFIG_IP_PNP=y
CONFIG_NET_SCHED=y
CONFIG_FW_LOADER=m
CONFIG_MTD=y
CONFIG_MTD_CMDLINE_PARTS=y
CONFIG_MTD_SPI_NAND=y
CONFIG_MTD_SPI_NOR=y
CONFIG_MTD_UBI=y
CONFIG_MTD_UBI_BEB_LIMIT=22
CONFIG_MTD_UBI_BLOCK=y
CONFIG_UBOOT_BOOTCOUNT=y
CONFIG_NETDEVICES=y
CONFIG_PHYLIB=y
CONFIG_DEVKMEM=y
CONFIG_TTY_PRINTK=y
CONFIG_HW_RANDOM=y
CONFIG_I2C=y
CONFIG_I2C_CHARDEV=y
CONFIG_SPI=y
CONFIG_GPIOLIB=y
CONFIG_GPIO_SYSFS=y
CONFIG_MT7621_WDT=y
CONFIG_MFD_SYSCON=y
CONFIG_PWM=y
CONFIG_GENERIC_PHY=y
CONFIG_OVERLAY_FS=y
CONFIG_CONFIGFS_FS=y
CONFIG_NFS_V4=y
CONFIG_NLS=y
CONFIG_CRYPTO_AUTHENC=y
CONFIG_PRINTK_TIME=y
CONFIG_POSIX_TIMERS=y
CONFIG_LEDS_GPIO=y
CONFIG_PINCTRL=y
CONFIG_PINCTRL_SINGLE=y
CONFIG_I2C_MT7621=y
CONFIG_GPIO_MT7621=y
CONFIG_SPI_MT7621=y
CONFIG_ETHERNET=y
CONFIG_MODULES=y
CONFIG_MODULE_UNLOAD=y
CONFIG_CFG80211=m
CONFIG_CFG80211_DEFAULT_PS=y
CONFIG_LEDS_CLASS=y
CONFIG_MAC80211=m
CONFIG_MAC80211_HAS_RC=y
CONFIG_MT7603E=m
CONFIG_MT76_CORE=m
CONFIG_MT76_LEDS=y
CONFIG_NEW_LEDS=y
CONFIG_PCI=y
CONFIG_PCI_DOMAINS=y
CONFIG_PCI_QUIRKS=y
CONFIG_WIRELESS=y
CONFIG_WLAN=y
CONFIG_WLAN_VENDOR_MEDIATEK=y
CONFIG_TTY=y
CONFIG_SERIAL_EARLYCON=y
CONFIG_SERIAL_8250=y
CONFIG_SERIAL_8250_DEPRECATED_OPTIONS=y
CONFIG_SERIAL_8250_CONSOLE=y
CONFIG_SERIAL_8250_NR_UARTS=3
CONFIG_SERIAL_8250_RUNTIME_UARTS=3
CONFIG_SERIAL_8250_RT288X=y
CONFIG_SERIAL_CORE=y
CONFIG_SERIAL_CORE_CONSOLE=y
CONFIG_SERIAL_MCTRL_GPIO=y
CONFIG_SERIAL_OF_PLATFORM=y
CONFIG_NET_VENDOR_RALINK=y
CONFIG_NET_RALINK_SOC=y
CONFIG_NET_RALINK_RT3050=y
CONFIG_NET_RALINK_ESW_RT3050=y
CONFIG_SWCONFIG=y
```

## recipes-kernel/linux/linux-yocto-tiny-5.10.99/at91sam9x5/defconfig
```kconfig
# Architecture
CONFIG_MMU=y
CONFIG_ARCH_AT91=y
CONFIG_ARCH_MULTI_V5=y
# CONFIG_SOC_AT91RM9200 is not set
# CONFIG_SOC_SAM9X60 is not set
CONFIG_SOC_AT91SAM9=y

# MTD
CONFIG_MTD_DATAFLASH=y
CONFIG_MTD_RAW_NAND=y
CONFIG_MTD_NAND_ATMEL=y

# hostname
CONFIG_DEFAULT_HOSTNAME="at91sam9x5"

# USB support
CONFIG_USB_SUPPORT=y
CONFIG_USB=y
CONFIG_USB_EHCI_HCD=y
CONFIG_USB_EHCI_HCD_AT91=y

# Networking drivers
CONFIG_ETHERNET=y
CONFIG_NETDEVICES=y
CONFIG_NET_VENDOR_CADENCE=y
CONFIG_MACB=y
CONFIG_DAVICOM_PHY=y
CONFIG_MICREL_PHY=y

# WLAN drivers
CONFIG_WLAN=y
CONFIG_WLAN_VENDOR_REALTEK=y
CONFIG_RTL_CARDS=m
CONFIG_RTL8192CU=m
CONFIG_RTLWIFI=m
CONFIG_RTLWIFI_USB=m
CONFIG_RTL8192C_COMMON=m
CONFIG_RTL8XXXU=m
CONFIG_RTL8XXXU_UNTESTED=y

# Unsorted
CONFIG_SERIAL_ATMEL=y
CONFIG_SERIAL_ATMEL_CONSOLE=y
CONFIG_SERIAL_ATMEL_PDC=y
CONFIG_AT91SAM9X_WATCHDOG=y
CONFIG_HW_RANDOM=y
CONFIG_HW_RANDOM_ATMEL=y
CONFIG_DMADEVICES=y
CONFIG_AT_HDMAC=y
CONFIG_ATMEL_TCLIB=y
CONFIG_LEDS_GPIO=y
CONFIG_ATMEL_EBI=y
CONFIG_ATMEL_CLOCKSOURCE_TCB=y
CONFIG_AT91_SOC_ID=y
CONFIG_PM=y
CONFIG_POWER_RESET_AT91_POWEROFF=y
CONFIG_POWER_RESET_AT91_RESET=y

# Enable GPIO userspace control
CONFIG_GPIO_SYSFS=y

# WEXT compatibility 8192cu driver
CONFIG_WEXT_CORE=y
CONFIG_WEXT_PROC=y
CONFIG_CFG80211_WEXT=y
```
